#ifndef HAMMING_H
#define HAMMING_H

#if defined(ARDUINO_ARCH_AVR)
#include <avr/pgmspace.h>
#else
#include <pgmspace.h>
#endif

const uint8_t hamming74_encode[16] PROGMEM = {
    0x00, 0x0F, 0x16, 0x19, 0x23, 0x2C, 0x35, 0x3A,
    0x45, 0x4A, 0x53, 0x5C, 0x66, 0x69, 0x70, 0x7F
};

const uint8_t hamming74_decode[128] PROGMEM = {
    0x00, 0x00, 0x00, 0x04, 0x00, 0x08, 0x02, 0x01,
    0x00, 0x03, 0x09, 0x01, 0x05, 0x01, 0x01, 0x01,
    0x00, 0x03, 0x02, 0x0A, 0x02, 0x06, 0x02, 0x02,
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    0x0E, 0x0D, 0x07, 0x0F, 0x0B, 0x0F, 0x0F, 0x0F
};

inline uint8_t encodeNibble(uint8_t nibble) {
    return pgm_read_byte(&hamming74_encode[nibble & 0x0F]);
}

inline uint8_t decodeNibble(uint8_t code) {
    return pgm_read_byte(&hamming74_decode[code & 0x7F]);
}

// Simple CRC8 implementation
inline uint8_t crc8(const uint8_t *data, size_t len) {
    uint8_t crc = 0x00;
    while (len--) {
        uint8_t extract = *data++;
        for (uint8_t tempI = 8; tempI; tempI--) {
            uint8_t sum = (crc ^ extract) & 0x01;
            crc >>= 1;
            if (sum) {
                crc ^= 0x8C;
            }
            extract >>= 1;
        }
    }
    return crc;
}

#endif
